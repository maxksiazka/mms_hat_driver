## Kconfig
```kconfig
# SPDX-License-Identifier: Apache-2.0

menu "MMS HAT Management Subsystem"

config MMS_HAT
	bool "MMS HAT Generic Container Driver"
	default y
	depends on MMS_CHAINBUS
	help
	  Enable generic HAT parent container driver that claims slots 
	  from the parent Chainbus controller.

config MMS_HAT_INIT_PRIORITY
	int "MMS HAT container initialization priority"
	default 56
	depends on MMS_HAT
	help
	  Init priority for HAT containers. Must run AFTER Chainbus init (60) 
	  and BEFORE child Virtual Bus Bridges (60).

config MMS_HAT_I2C_BRIDGE
	bool "MMS HAT Virtual I2C Bridge Driver"
	default y
	depends on MMS_HAT
	depends on I2C
	help
	  Enable virtual I2C bridge driver that routes transfers to 
	  parent controller while managing slot CS lines.

config MMS_HAT_I2C_BRIDGE_INIT_PRIORITY
	int "MMS HAT I2C bridge initialization priority"
	default 60
	depends on MMS_HAT_I2C_BRIDGE
	help
	  Init priority for HAT I2C bridges. Must run AFTER HAT container init (50).

config MMS_HAT_SPI_BRIDGE
	bool "MMS HAT Virtual SPI Bridge Driver"
	default y
	depends on MMS_HAT
	depends on SPI
	help
	  Enable virtual SPI bridge driver that routes transfers to 
	  parent controller while managing slot CS lines.

config MMS_HAT_SPI_BRIDGE_INIT_PRIORITY
	int "MMS HAT SPI bridge initialization priority"
	default 60
	depends on MMS_HAT_SPI_BRIDGE
	help
	  Init priority for HAT SPI bridges. Must run AFTER HAT container init (50).

config MMS_HAT_UART_BRIDGE
	bool "MMS HAT Virtual UART Bridge Driver"
	default y
	depends on MMS_HAT
	depends on SERIAL
	help
	  Enable virtual UART bridge driver that routes transfers to 
	  parent controller while managing slot CS lines.

config MMS_HAT_UART_BRIDGE_INIT_PRIORITY
	int "MMS HAT UART bridge initialization priority"
	default 60
	depends on MMS_HAT_UART_BRIDGE
	help
	  Init priority for HAT UART bridges. Must run AFTER HAT container init (50).

endmenu
```

## dts/bindings/mms_hat/konar,mms-hat.yaml
```yaml
# SPDX-License-Identifier: Apache-2.0
# dts/bindings/mms_hat/mms3,hat-base.yaml

description: |
  Abstract base schema for all MMS3 HAT expansion modules

compatible: "konar,mms-hat"

include: base.yaml

properties:
  reg:
    type: array
    min: 0
    max: 7
    description: |
      Slot address for the MMS HAT module. The slot is a number from 0 to 7, representing the distance from the baseboard.
      Omit for runtime detection of the slot address. If specified, the slot address must be unique for each HAT module.

  type-id:
    type: int
    description: |
      Type ID of the MMS HAT module. This is a unique identifier for the module type, used for runtime detection and validation.
      Either this or the reg property must be specified. If both are specified, the reg will be used for validation.
```

## dts/bindings/mms_hat/spi/konar,mms-hat-spi-bridge.yaml
```yaml
# SPDX-License-Identifier: MIT
description: MMS3 Virtual SPI Slot Bridge Controller

compatible: "konar,mms-hat-spi-bridge"

include: spi-controller.yaml


properties:
  spi-bus:
    type: phandle
    required: true
    description: Physical parent SPI controller (e.g. &spi3)

  cs-gpios:
    type: phandle-array
    required: false
    description: Chip select GPIO line for this slot (if pin-driven)
```

## dts/bindings/mms_hat/uart/konar,mms-hat-uart-bridge.yaml
```yaml
# SPDX-License-Identifier: Apache-2.0
# dts/bindings/mms_hat/mms-hat,uart-bridge.yaml

description: MMS3 Slot UART Controller Bridge

compatible: "konar,mms-hat-uart-bridge"

include: uart-controller.yaml


properties:
  uart-bus:
    type: phandle
    required: true
    description: |
      Phandle to the physical UART controller (e.g. &uart0)
```
